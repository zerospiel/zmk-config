## config/west.yml
```yaml
manifest:
  remotes:
    - name: zmkfirmware # zmk
      url-base: https://github.com/zmkfirmware
    - name: zmk-zerospiel # zmk fork
      url-base: https://github.com/zerospiel
    - name: duckyb # urchin hw
      url-base: https://github.com/duckyb
    - name: dhruvinsh # tri-state module
      url-base: https://github.com/dhruvinsh
  projects:
    # firmware
    - name: zmk
      remote: zmk-zerospiel
      revision: main
      import: app/west.yml
    # board/shield for the urchin kb
    - name: urchin-zmk-module
      remote: duckyb
      revision: main
    # tri-state (basically swapper from the QMK/Callum)
    - name: zmk-tri-state
      remote: dhruvinsh
      revision: main
  self:
    path: config
```
